## meta-kr260/conf/layer.conf
```bitbake
# We have a conf and classes directory, add to BBPATH
BBPATH .= ":${LAYERDIR}"

# We have recipes-* directories, add to BBFILES
BBFILES += "${LAYERDIR}/recipes-*/*/*.bb \
            ${LAYERDIR}/recipes-*/*/*.bbappend"

BBFILE_COLLECTIONS += "kr260"
BBFILE_PATTERN_kr260 = "^${LAYERDIR}/"
BBFILE_PRIORITY_kr260 = "6"

LAYERDEPENDS_kr260 = "core xilinx kria"
LAYERSERIES_COMPAT_kr260 = "scarthgap"
```

## tools/image.its
```
/dts-v1/;

/ {
    description = "Custom Linux image.ub";
    #address-cells = <2>;

    images {
        kernel {
            description = "Linux kernel";
            data = /incbin/("Image.bin.gz");
            type = "kernel";
            arch = "arm64";
            os = "linux";
            compression = "gzip";
            load = <0x00000000 0x00200000>;
            entry = <0x00000000 0x00200000>;
            hash {
                algo = "sha256";
            };
        };

        fdt {
            description = "Flattened Device Tree";
            data = /incbin/("system.dtb");
            type = "flat_dt";
            arch = "arm64";
            compression = "none";
            hash {
                algo = "sha256";
            };
        };
    };

    configurations {
        default = "conf";

        conf {
            description = "Boot Linux kernel with FDT blob";
            kernel = "kernel";
            fdt = "fdt";
        };
    };
};
```
